## buildroot/package/userdefinedapps/Config.in
```kconfig
source "package/userdefinedapps/gpio_web/Config.in"
source "package/userdefinedapps/zigbee2mqtt-bin/Config.in"
```

## buildroot/package/userdefinedapps/zigbee2mqtt-bin/Config.in
```kconfig
config BR2_PACKAGE_ZIGBEE2MQTT_BIN
    bool "zigbee2mqtt (precompiled)"
    help
      Zigbee binary - from https://github.com/Koenkk/zigbee2mqtt/releases/
```
